## components/espos_eth/Kconfig
```kconfig
menu "espOS Ethernet"

    choice ESPOS_ETH_CONTROLLER
        prompt "Ethernet controller"
        default ESPOS_ETH_CONTROLLER_EMAC if ETH_USE_ESP32_EMAC
        default ESPOS_ETH_CONTROLLER_NONE
        help
            What carries the cable. The chip's internal EMAC with an RMII PHY
            (ESP32, ESP32-P4), or a WIZnet W5500 on SPI, which works on any
            chip and is what boards without an EMAC use, such as the Waveshare
            ESP32-S3-ETH-8DI-8RO-C. With none, espos_eth_start() returns
            ESP_ERR_NOT_SUPPORTED.

        config ESPOS_ETH_CONTROLLER_EMAC
            bool "Internal EMAC with an RMII PHY"
            depends on ETH_USE_ESP32_EMAC

        config ESPOS_ETH_CONTROLLER_W5500
            bool "WIZnet W5500 on SPI"
            depends on !IDF_TARGET_LINUX

        config ESPOS_ETH_CONTROLLER_NONE
            bool "None"
    endchoice

    # The one test for "this build has Ethernet", so a third controller is
    # added in one place.
    config ESPOS_ETH_HAVE_CONTROLLER
        bool
        default y if !ESPOS_ETH_CONTROLLER_NONE

    config ESPOS_ETH_PHY_ADDR
        int "PHY address (-1 to detect)"
        depends on ESPOS_ETH_CONTROLLER_EMAC
        default 1 if IDF_TARGET_ESP32P4
        default -1
        range -1 31
        help
            The MDIO address of the RMII PHY. The Waveshare
            ESP32-P4-WIFI6-POE-ETH strap-configures its IP101GRI at 1, which is
            the ESP32-P4 default here. -1 makes the driver scan the bus at
            start, which works on a board with one PHY and costs a little
            start-up time.

    config ESPOS_ETH_PHY_RST_GPIO
        int "PHY reset GPIO (-1 for none)"
        depends on ESPOS_ETH_CONTROLLER_EMAC
        default 51 if IDF_TARGET_ESP32P4
        default -1
        range -1 63
        help
            The GPIO wired to the PHY's active-low reset, pulsed low at start.
            GPIO 51 on the Waveshare ESP32-P4-WIFI6-POE-ETH. -1 for a board
            whose PHY comes out of reset on its own. A wrong pin here does not
            fail loudly: the PHY simply never answers, which looks the same as
            no cable.

    if ESPOS_ETH_CONTROLLER_W5500
        # The defaults are the Waveshare ESP32-S3-ETH-8DI-8RO-C, the one
        # W5500 board in the registry. Any other board sets its own.

        config ESPOS_ETH_W5500_SPI_HOST
            int "SPI host (1 = SPI2, 2 = SPI3)"
            default 1
            range 1 2 if SOC_SPI_PERIPH_NUM > 2
            range 1 1
            help
                The SPI peripheral the W5500 is on. SPI2 exists on every chip;
                SPI3 only on some (ESP32, ESP32-S3). An app that already set
                this bus up, for another device on the same lines, keeps its
                setup: espos_eth adds the W5500 to it.

        config ESPOS_ETH_W5500_SCLK_GPIO
            int "SCLK GPIO"
            default 15
            range 0 63

        config ESPOS_ETH_W5500_MOSI_GPIO
            int "MOSI GPIO"
            default 13
            range 0 63

        config ESPOS_ETH_W5500_MISO_GPIO
            int "MISO GPIO"
            default 14
            range 0 63

        config ESPOS_ETH_W5500_CS_GPIO
            int "CS GPIO"
            default 16
            range 0 63

        config ESPOS_ETH_W5500_INT_GPIO
            int "INT GPIO (-1 to poll)"
            default 12
            range -1 63
            help
                The W5500's active-low interrupt line. -1 for a board that does
                not wire it: the driver then polls the chip every
                ESPOS_ETH_W5500_POLL_MS.

        config ESPOS_ETH_W5500_POLL_MS
            int "Poll period without an INT line (ms)"
            default 10
            range 1 1000
            help
                Used only when ESPOS_ETH_W5500_INT_GPIO is -1.

        config ESPOS_ETH_W5500_RST_GPIO
            int "Reset GPIO (-1 for none)"
            default -1
            range -1 63
            help
                The W5500's active-low reset, pulsed low at start. The Waveshare
                ESP32-S3-ETH-8DI-8RO-C does not wire it to the ESP32-S3.

        config ESPOS_ETH_W5500_SPI_MHZ
            int "SPI clock (MHz)"
            default 20
            range 1 80
            help
                The W5500 is specified to 80 MHz, but board traces rarely carry
                that. 20 MHz moves several Mbit/s, far more than a Signal K
                device sends, and leaves margin on a board nobody has measured.
    endif

endmenu
```

## components/espos_health/Kconfig
```kconfig
menu "espOS health"

    config ESPOS_HEALTH_MAX_CONDITIONS
        int "Distinct condition keys"
        default 12
        range 5 32
        help
            Slots for remembered conditions, one per key (~128 bytes each,
            reserved for the life of the firmware). The set of conditions a
            firmware can raise is fixed at build time, so size this to what
            it actually raises; further keys are rejected with ESP_ERR_NO_MEM.
            espOS itself uses five: lowMemory, memoryTrough, taskStalled,
            netDown and skLinkStalled, which is why the minimum is 5 rather
            than 1. A table too small to hold them drops one silently, and if
            the dropped key is a fatal one the device stops restarting on a
            condition that should restart it. Raise this for a firmware that
            adds keys of its own.

    config ESPOS_HEALTH_MAX_SINKS
        int "Health sinks"
        default 4
        range 1 8
        help
            How many consumers may register for condition changes. espos_sk
            takes one when SignalK notifications are enabled; an application
            wanting a status LED or a line on a display takes another.

    menu "Watchdog policy"

        config ESPOS_HEALTH_POLICY_TICK_S
            int "Policy tick (seconds)"
            default 10
            range 1 60
            help
                How often the policy reads the heap, re-evaluates the built-in
                conditions and counts strikes. With the default strikes below,
                a fatal condition has to be held for tick × strikes = 30 s
                before the device restarts.

        config ESPOS_HEALTH_POLICY_STRIKES
            int "Consecutive fatal ticks before a restart"
            default 3
            range 1 10
            help
                A condition raised with ESPOS_HEALTH_F_REBOOT_ON_ALARM must be
                in ALARM on this many consecutive ticks for the device to
                restart; one tick without it resets the count. A warning or
                an ALARM without the flag never restarts anything.

        config ESPOS_HEALTH_HEAP_WARN_KB
            int "lowMemory: warn below total free heap (KB)"
            default 40
            range 0 4096
            help
                Warning only. 0 disables the check.

        config ESPOS_HEALTH_INTERNAL_WARN_KB
            int "lowMemory: warn below free internal RAM (KB)"
            default 20
            range 0 4096
            help
                Internal RAM is judged separately from the total because on a
                board with PSRAM it is the scarce pool: the radio, DMA and
                every task stack come from it, and tens of megabytes free
                overall can hide its exhaustion. Warning only; 0 disables.

        config ESPOS_HEALTH_INTERNAL_ALARM_KB
            int "lowMemory: fatal alarm below free internal RAM (KB)"
            default 12
            range 0 4096
            help
                Below this the device is about to lose the radio or a task
                stack, and a restart is the recovery. Held for the strike
                window it restarts the device. 0 disables.

                Sits below the deepest legitimate trough seen so far: an
                ESP32-P4 panel measured ~24 KB free / ~23 KB largest block
                while esp-sr's wake pipeline allocates at start, settling
                near 95 KB afterwards. A threshold above that trough would
                restart the panel on every boot.

        config ESPOS_HEALTH_INTERNAL_TROUGH_WARN_KB
            int "memoryTrough: warn if the internal-RAM low-water mark is below (KB)"
            default 10
            range 0 4096
            help
                Warning only, never fatal, and reported as its own condition
                (`memoryTrough`) rather than folded into `lowMemory`.

                The checks above read the free size on a tick, so a trough
                BETWEEN two ticks is invisible to them -- and a transient
                trough is what precedes an allocation failure. A Waveshare
                ESP32-C5 running the BLE gateway measured 27604 B free after
                27 hours with a low-water mark of 4924 B, and 148 B on a later
                run. No tick came near either: each read a free size well
                above the fatal floor. The mark is a sum of per-region
                floors, so it does not prove the TOTAL ever got that low --
                but the parts sum to it, so every internal region had been
                within 148 B of exhaustion at its own worst moment, and an
                allocation fails on a region, not on the total.

                Default 10, below the 12 KB fatal floor: a device that got
                close enough to restarting to be worth mentioning, but not
                so close that the live alarm would already have fired. Raise
                it to hear about a smaller dip; 0 disables.

                Never fatal by construction. A low-water mark does not
                recover within a boot, so a fatal condition on it would
                reboot, see the same mark on the next boot's first dip, and
                reboot again.

        config ESPOS_HEALTH_LARGEST_BLOCK_ALARM_KB
            int "lowMemory: fatal alarm below largest free internal block (KB)"
            default 8
            range 0 4096
            help
                Fragmentation check: the free total can look fine while no
                single block is left for a socket buffer or a task stack.
                Same trough as above applies (~23 KB largest block seen). 0
                disables.

    endmenu

endmenu
```

## components/espos_n2k/Kconfig
```kconfig
menu "espOS NMEA 2000"

    config ESPOS_N2K_CANDUMP_PORT
        int "candump TCP server port"
        default 2599
        range 1 65535
        help
            Default listening port of CandumpTcpServer
            (CandumpTcpServerConfig::port overrides it per instance). 2599 is
            what the SensESP-era gateway listened on and what existing
            canboatjs / SignalK n2k-ip-gateway sources have configured by
            hand; clients that browse mDNS take the port from the record and
            do not care.

    config ESPOS_N2K_RX_QUEUE_DEPTH
        int "TWAI receive queue depth (frames)"
        default 64
        range 8 1024
        help
            Frames the TWAI node's ISR hands to its task before the oldest
            is dropped. A saturated 250 kbit/s bus delivers roughly 1900
            frames a second, so 64 is about 30 ms of backlog -- enough for
            the task to be held off briefly by WiFi or a display refresh,
            not for a stalled consumer. Each slot is one CanMessage (about
            32 bytes).

    config ESPOS_N2K_MDNS_LEGACY_TYPE
        bool "Advertise the legacy _sensesp-n2k._tcp service type"
        default y
        help
            Register the candump server with mDNS as _sensesp-n2k._tcp with
            model=sensesp-n2k-gateway, the names the SensESP-based gateway
            used. They are on the wire: SignalK's n2k-ip-gateway-canboatjs
            source browses for exactly this type and every deployed client
            has it configured, so renaming would make every gateway
            invisible to every client for the sake of tidiness. Off switches
            to _espos-n2k._tcp / model=espos-n2k-gateway, which no released
            client looks for yet.

    config ESPOS_N2K_MAX_LISTENERS
        int "Frame listeners per receiver"
        default 4
        range 1 16
        help
            How many consumers TwaiReceiver::add_listener() can feed from one
            bus: the candump server takes one, an NMEA 2000 node one, and the
            application whatever it adds. Each slot is a std::function
            (16 bytes on these targets) whether used or not.

    config ESPOS_N2K_NODE
        bool "NMEA 2000 node (espos_n2k::Node)"
        default n
        help
            Build espos_n2k::Node, which makes the device a node on the bus
            in its own right: a NAME, the ISO address claim, answers to ISO
            requests, product information, the PGN lists, a heartbeat and the
            device/system instances an MFD can set. It is the NMEA2000
            library (Timo Lappalainen, MIT), vendored under third_party/,
            over this component's receiver and transmitter.

            Off by default because it is not free and a bridge does not need
            it: on adds the library (about 28 KB of flash on esp32s3 with what a
            node uses) and the "NMEA 2000" settings page with the instance keys.
            A pure candump gateway leaves it off and lets the server supply
            the identity.

    if ESPOS_N2K_NODE

    config ESPOS_N2K_NODE_TASK_STACK
        int "Node task stack (bytes)"
        default 4096
        range 3072 16384
        help
            The node task runs the library's ParseMessages() and every
            message listener the application adds to the node.

    config ESPOS_N2K_NODE_TX_QUEUE
        int "Messages Node::send() can queue"
        default 8
        range 2 64
        help
            Node::send() is callable from any task: it copies the message
            into this queue and the node task hands it to the library. Each
            slot is one tN2kMsg (about 250 bytes), so the default costs
            about 2 KB of RAM.

    endif

endmenu
```
